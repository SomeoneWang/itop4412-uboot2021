## configs/itop4412_defconfig
```kconfig
CONFIG_ARM=y
CONFIG_SYS_DCACHE_OFF=y
CONFIG_ARCH_CPU_INIT=y
CONFIG_ARCH_EXYNOS=y
CONFIG_SYS_TEXT_BASE=0x43E00000
CONFIG_ARCH_EXYNOS4=y
CONFIG_TARGET_ITOP4412=y
CONFIG_ENV_SIZE=0x2000
CONFIG_ENV_OFFSET=0x86200
CONFIG_ENV_IS_IN_MMC=y
CONFIG_SPL=y
CONFIG_SPL_ENV_SUPPORT=y
CONFIG_IDENT_STRING=" for ITOP4412"
CONFIG_SPL_TEXT_BASE=0x02023400
CONFIG_DISTRO_DEFAULTS=y
# CONFIG_USE_BOOTCOMMAND is not set
CONFIG_SYS_CONSOLE_IS_IN_ENV=y
CONFIG_SYS_CONSOLE_INFO_QUIET=y
# CONFIG_SPL_FRAMEWORK is not set
CONFIG_SYS_PROMPT="ITOP4412 # "
# CONFIG_CMD_XIMG is not set
CONFIG_CMD_THOR_DOWNLOAD=y
CONFIG_CMD_DFU=y
CONFIG_CMD_GPT=y
CONFIG_CMD_MMC=y
CONFIG_CMD_USB=y
CONFIG_CMD_TFTPPUT=y
CONFIG_CMD_SOURCE=y
CONFIG_CMD_SAVEENV=y
CONFIG_CMD_RUN=y
CONFIG_CMD_PING=y
CONFIG_CMD_PART=y
CONFIG_CMD_NFS=y
CONFIG_CMD_MII=y
CONFIG_CMD_FDT=y
CONFIG_CMD_FLASH=y
CONFIG_CMD_GO=y
CONFIG_CMD_IMPORTENV=y
CONFIG_CMD_FS_GENERIC=y
CONFIG_CMD_ENV_EXISTS=y
CONFIG_CMD_DHCP=y
CONFIG_CMD_DM=y
CONFIG_CMD_EDITENV=y
CONFIG_CMD_USB_MASS_STORAGE=y
CONFIG_CMD_NET=y
CONFIG_CMD_CACHE=y
# CONFIG_CMD_MISC is not set
CONFIG_CMD_EXT4_WRITE=y
CONFIG_OF_CONTROL=y
CONFIG_DEFAULT_DEVICE_TREE="exynos4412-itop4412"
CONFIG_SYS_RELOC_GD_ENV_ADDR=y
#CONFIG_SYS_MMC_ENV_PART=y
CONFIG_DFU_MMC=y
CONFIG_MMC_BROKEN_CD=y
CONFIG_MMC_DW=y
CONFIG_MMC_SDHCI=y
CONFIG_MMC_SDHCI_SDMA=y
CONFIG_MMC_SDHCI_S5P=y
CONFIG_MTD=y
CONFIG_DM_USB=y
CONFIG_DM=y
CONFIG_DM_ETH=y
CONFIG_DM_MMC=y
CONFIG_USB=y
CONFIG_USB_HOST=y
CONFIG_USB_GADGET=y
CONFIG_USB_FUNCTION_DFU=y
CONFIG_USB_GADGET_DUALSPEED=y
CONFIG_USB_GADGET_MANUFACTURER="Samsung"
CONFIG_USB_GADGET_VENDOR_NUM=0x04e8
CONFIG_USB_GADGET_PRODUCT_NUM=0x6601
CONFIG_USB_GADGET_DWC2_OTG=y
CONFIG_USB_GADGET_DOWNLOAD=y
CONFIG_USB_FUNCTION_THOR=y
CONFIG_USB_HOST_ETHER=y
CONFIG_USB_ETHER_DM9601=y
CONFIG_USB_EHCI_HCD=y
CONFIG_USB_GADGET_VBUS_DRAW=2
CONFIG_NET=y
#CONFIG_USB_ETHER_SMSC95XX
#CONFIG_SYS_USB_EHCI_MAX_ROOT_PORTS 3

CONFIG_DEBUG_UART=y
CONFIG_SPL_SERIAL_SUPPORT=y
CONFIG_SPL_GPIO_SUPPORT=y
CONFIG_BOARD_EARLY_INIT_F=y
CONFIG_DEBUG_UART_BASE=0x13820000
CONFIG_DEBUG_UART_CLOCK=100000000
CONFIG_SYS_MMC_ENV_DEV=1
```
